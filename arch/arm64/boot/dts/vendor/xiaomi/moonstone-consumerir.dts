&qupv3_se2_spi {
    status = "ok";

    irled@0 {
        compatible = "ir-spi-led";
        reg = <0>;
        spi-max-frequency = <19200000>;
        status = "ok";
        irda_regulator = <&L7E>; // pakai node regulator existing
    };
};